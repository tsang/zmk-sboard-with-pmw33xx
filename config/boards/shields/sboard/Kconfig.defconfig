## config/boards/shields/sboard/Kconfig.defconfig
```kconfig
if SHIELD_SBOARD_LEFT

config ZMK_SPLIT_ROLE_CENTRAL
    default n

config ZMK_SPLIT_BLE_ROLE_CENTRAL
    default n

config NICE_NANO_SHIELD_MASTER
    default n

endif

if SHIELD_SBOARD_RIGHT

config ZMK_SPLIT_ROLE_CENTRAL
    default y

config ZMK_SPLIT_BLE_ROLE_CENTRAL
    default y

config NICE_NANO_SHIELD_MASTER
    default y
endif


if SHIELD_SBOARD_LEFT || SHIELD_SBOARD_RIGHT

config ZMK_KEYBOARD_NAME
    default "sboard"

config ZMK_SPLIT
    default y

endif
```

## config/boards/shields/sboard/Kconfig.shield
```kconfig
config SHIELD_SBOARD_LEFT
    def_bool $(shields_list_contains,sboard_left)

config SHIELD_SBOARD_RIGHT
    def_bool $(shields_list_contains,sboard_right)
```

## config/west.yml
```yaml
manifest:
  remotes:
    - name: zmkfirmware
      url-base: https://github.com/zmkfirmware
    - name: ALpotato
      url-base:https://github.com/ALpotato
    # Additional modules containing boards/shields/custom code can be listed here as well
    # See https://docs.zephyrproject.org/3.2.0/develop/west/manifest.html#projects
  projects:
    - name: zmk
      remote: ALpotato
      revision: main
      import: app/west.yml
  self:
    path: config
```
