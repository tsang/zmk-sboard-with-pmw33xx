#include "sboard.dtsi"

&default_transform { // The matrix transform for this board is 4 rows over because the left half is 4 rows tall according to the matrix.
    row-offset = <4>;
};

&trackball {
    status = "okay";
};
